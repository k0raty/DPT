#include <Wire.h>

int ADDRESS = 0x69;
int command[64] = {0x80, 0x82, 0x84, 0x86, 0x88, 0x8A, 0x8C, 0x8E, 0x90, 0x92, 0x94, 0x96, 0x98,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 0xFC, 0xFE};
int pixels[64];

int X0;
int i;

void setup() {
  byte error;
  // put your setup code here, to run once:
  Wire.begin();
  Serial.begin(9600);
  delay (100);
  Wire.beginTransmission(ADDRESS);
  Wire.write(8);  
  Wire.write(4);
  error=Wire.endTransmission();
}

void loop() {
  // put your main code here, to run repeatedly:
  for (i=1 ; i <= 64 ; i++){
    Wire.beginTransmission(ADDRESS);
    Wire.write(command[i]);
   
    Wire.endTransmission();

    Wire.requestFrom(ADDRESS,2);

    if(Wire.available ()<=2)
    {
      X0 = Wire.read();
    }
    pixels[i-1]=X0;
  }
  Serial.print("[");
  for(int i=1; i<=64; i++){
    Serial.print(pixels[i-1]);
    Serial.print(", ");
    if( i%8 == 0 ) Serial.println();
  }
  Serial.println("]");
  Serial.println();

  //delay a second
  delay(1000);
   
}